## Documentation/devicetree/bindings/input/qcom,spmi-haptics.yaml
```yaml
# SPDX-License-Identifier: (GPL-2.0-only OR BSD-2-Clause)
%YAML 1.2
---
$id: http://devicetree.org/schemas/input/qcom,spmi-haptics.yaml#
$schema: http://devicetree.org/meta-schemas/core.yaml#

title: Qualcomm PMI8998 buffer-mode LRA haptics

maintainers:
  - adkaore <adkaore@gmail.com>

description: |
  PMI8998 drives a linear resonant actuator using an internal waveform buffer.
  The driver implements ff-memless rumble. ERM, audio/PWM modes and downstream
  custom effect tables are not implemented. The factory RC oscillator trim
  must be supplied by NVMEM, not replaced with a constant from another device.

properties:
  compatible:
    items:
      - const: qcom,pmi8998-haptics
      - const: qcom,spmi-haptics

  reg:
    items:
      - const: 0xc000

  interrupts:
    minItems: 1
    items:
      - description: Short circuit
      - description: End of waveform buffer (unused for repeating rumble)

  interrupt-names:
    minItems: 1
    items:
      - const: short
      - const: play

  nvmem-cells:
    maxItems: 1

  nvmem-cell-names:
    const: rc-trim

  qcom,actuator-type:
    $ref: /schemas/types.yaml#/definitions/uint32
    const: 0
    description: Linear resonant actuator.

  qcom,play-mode:
    $ref: /schemas/types.yaml#/definitions/uint32
    const: 1
    description: Internal buffer mode.

  qcom,wave-shape:
    $ref: /schemas/types.yaml#/definitions/uint32
    const: 0
    description: Sine waveform.

  qcom,vmax-mv:
    $ref: /schemas/types.yaml#/definitions/uint32
    minimum: 116
    maximum: 3596
    description: Board voltage ceiling in millivolts; quantization rounds down.

  qcom,ilim-ma:
    $ref: /schemas/types.yaml#/definitions/uint32
    enum: [400, 800]
    description: Hardware current limit in milliamps.

  qcom,sc-dbc-cycles:
    $ref: /schemas/types.yaml#/definitions/uint32
    enum: [0, 8, 16, 32]
    description: Short-circuit debounce cycles.

  qcom,wave-play-rate-us:
    minimum: 5
    maximum: 20475
    description: Untrimmed resonance period in microseconds.

  qcom,lra-auto-res-mode:
    $ref: /schemas/types.yaml#/definitions/uint32
    enum: [1, 2, 3, 4]
    description: Auto resonance mode (ZXD, QWD, maximum QWD, ZXD at end of pattern).

  qcom,lra-high-z:
    $ref: /schemas/types.yaml#/definitions/uint32
    minimum: 0
    maximum: 3
    description: High impedance interval hardware code.

  qcom,lra-res-cal-period:
    $ref: /schemas/types.yaml#/definitions/uint32
    enum: [4, 8, 16, 32]
    description: Resonance calibration period.

  qcom,brake-pattern:
    $ref: /schemas/types.yaml#/definitions/uint32-array
    minItems: 4
    maxItems: 4
    items:
      minimum: 0
      maximum: 3
    description: Four brake strengths, from zero to full drive voltage.

required:
  - compatible
  - reg
  - interrupts
  - interrupt-names
  - nvmem-cells
  - nvmem-cell-names
  - qcom,actuator-type
  - qcom,play-mode
  - qcom,wave-shape
  - qcom,vmax-mv
  - qcom,ilim-ma
  - qcom,sc-dbc-cycles
  - qcom,wave-play-rate-us
  - qcom,lra-auto-res-mode
  - qcom,lra-high-z
  - qcom,lra-res-cal-period
  - qcom,brake-pattern

additionalProperties: false

examples:
  - |
    #include <dt-bindings/interrupt-controller/irq.h>
    pmic {
        #address-cells = <1>;
        #size-cells = <0>;
        interrupt-controller;
        #interrupt-cells = <4>;

        haptics@c000 {
            compatible = "qcom,pmi8998-haptics", "qcom,spmi-haptics";
            reg = <0xc000>;
            interrupts = <3 0xc0 0 IRQ_TYPE_EDGE_BOTH>;
            interrupt-names = "short";
            nvmem-cells = <&rc_trim>;
            nvmem-cell-names = "rc-trim";
            qcom,actuator-type = <0>;
            qcom,play-mode = <1>;
            qcom,wave-shape = <0>;
            qcom,vmax-mv = <3100>;
            qcom,ilim-ma = <800>;
            qcom,sc-dbc-cycles = <8>;
            qcom,wave-play-rate-us = <4878>;
            qcom,lra-auto-res-mode = <2>;
            qcom,lra-high-z = <1>;
            qcom,lra-res-cal-period = <4>;
            qcom,brake-pattern = <3 3 2 1>;
        };
    };
```

## Documentation/devicetree/bindings/input/touchscreen/st,stmfts-ftm5.yaml
```yaml
# SPDX-License-Identifier: (GPL-2.0-only OR BSD-2-Clause)
%YAML 1.2
---
$id: http://devicetree.org/schemas/input/touchscreen/st,stmfts-ftm5.yaml#
$schema: http://devicetree.org/meta-schemas/core.yaml#

title: STMicroelectronics FTM5 resident-firmware touchscreen

maintainers:
  - adkaore <adkaore@gmail.com>

description: |
  I2C FTM5 touchscreen with chip identifier bytes 0x36 and 0x39. The driver
  uses already programmed firmware and does not update flash or calibration.
  It supports ten multitouch contacts but not wake gestures or stylus/hover.

allOf:
  - $ref: touchscreen.yaml#

properties:
  compatible:
    const: st,stmfts-ftm5

  reg:
    maxItems: 1

  interrupts:
    maxItems: 1

  reset-gpios:
    maxItems: 1
    description: Active-low controller reset

  vdd-supply:
    description: I/O power supply

  avdd-supply:
    description: Analog power supply

  touchscreen-size-x:
    minimum: 1
    maximum: 4096

  touchscreen-size-y:
    minimum: 1
    maximum: 4096

required:
  - compatible
  - reg
  - interrupts
  - reset-gpios
  - vdd-supply
  - avdd-supply
  - touchscreen-size-x
  - touchscreen-size-y

unevaluatedProperties: false

examples:
  - |
    #include <dt-bindings/gpio/gpio.h>
    #include <dt-bindings/interrupt-controller/irq.h>

    i2c {
        #address-cells = <1>;
        #size-cells = <0>;

        touchscreen@49 {
            compatible = "st,stmfts-ftm5";
            reg = <0x49>;
            interrupt-parent = <&gpio>;
            interrupts = <31 IRQ_TYPE_LEVEL_LOW>;
            reset-gpios = <&gpio 32 GPIO_ACTIVE_LOW>;
            vdd-supply = <&touch_io>;
            avdd-supply = <&touch_analog>;
            touchscreen-size-x = <1080>;
            touchscreen-size-y = <2248>;
        };
    };
...
```

## Documentation/devicetree/bindings/media/i2c/sony,imx363.yaml
```yaml
# SPDX-License-Identifier: (GPL-2.0-only OR BSD-2-Clause)
%YAML 1.2
---
$id: http://devicetree.org/schemas/media/i2c/sony,imx363.yaml#
$schema: http://devicetree.org/meta-schemas/core.yaml#

title: Sony IMX363 image sensor

maintainers:
  - adkaore <adkaore@gmail.com>

description: |
  Sony IMX363 camera sensor connected through I2C and a four-lane MIPI CSI-2
  D-PHY interface. This initial driver exposes a candidate 4032x3024 RAW10
  mode with a 24 MHz input clock. Lens actuator, OIS, EEPROM calibration
  and Android camera-provider support are separate from this sensor node.

allOf:
  - $ref: /schemas/media/video-interface-devices.yaml#

properties:
  compatible:
    const: sony,imx363

  reg:
    maxItems: 1

  clocks:
    maxItems: 1

  clock-names:
    items:
      - const: xvclk

  clock-frequency:
    const: 24000000

  reset-gpios:
    maxItems: 1
    description: Active-low reset signal

  vana-supply:
    description: Analog supply

  vdig-supply:
    description: Digital core supply

  vif-supply:
    description: I/O supply

  port:
    $ref: /schemas/graph.yaml#/$defs/port-base
    additionalProperties: false
    properties:
      endpoint:
        $ref: /schemas/media/video-interfaces.yaml#
        unevaluatedProperties: false
        properties:
          data-lanes:
            minItems: 4
            maxItems: 4
            uniqueItems: true
            items:
              minimum: 0
              maximum: 4

          link-frequencies:
            items:
              - const: 636000000

        required:
          - data-lanes
          - link-frequencies

required:
  - compatible
  - reg
  - clocks
  - vana-supply
  - vdig-supply
  - vif-supply
  - port

unevaluatedProperties: false

examples:
  - |
    #include <dt-bindings/gpio/gpio.h>

    i2c {
        #address-cells = <1>;
        #size-cells = <0>;

        camera@1a {
            compatible = "sony,imx363";
            reg = <0x1a>;
            clocks = <&camclk>;
            clock-names = "xvclk";
            reset-gpios = <&gpio 119 GPIO_ACTIVE_LOW>;
            vana-supply = <&camera_analog>;
            vdig-supply = <&camera_digital>;
            vif-supply = <&camera_io>;

            port {
                endpoint {
                    data-lanes = <1 2 3 4>;
                    link-frequencies = /bits/ 64 <636000000>;
                };
            };
        };
    };
...
```

## Documentation/devicetree/bindings/nvmem/qcom,pmi8998-rc-trim.yaml
```yaml
# SPDX-License-Identifier: (GPL-2.0-only OR BSD-2-Clause)
%YAML 1.2
---
$id: http://devicetree.org/schemas/nvmem/qcom,pmi8998-rc-trim.yaml#
$schema: http://devicetree.org/meta-schemas/core.yaml#

title: Qualcomm PMI8998 factory RC19P2 oscillator trim

maintainers:
  - adkaore <adkaore@gmail.com>

description: |
  Read-only view of the single factory trim byte at offset 0xf3 in the
  PMI8998 MISC peripheral at 0x900 on the base SPMI USID. NVMEM offset zero
  exposes this byte only. Bit 7 is the correction sign; bits 3:0 encode
  the absolute correction in 0.7 percent units. Other PMIC registers are
  not exposed and no writes or calibration programming are supported.

allOf:
  - $ref: nvmem.yaml#

properties:
  compatible:
    const: qcom,pmi8998-rc-trim

  reg:
    items:
      - const: 0x9f3

required:
  - compatible
  - reg

unevaluatedProperties: false

examples:
  - |
    pmic {
        #address-cells = <1>;
        #size-cells = <0>;

        nvram@9f3 {
            compatible = "qcom,pmi8998-rc-trim";
            reg = <0x9f3>;
            nvmem-layout {
                compatible = "fixed-layout";
                #address-cells = <1>;
                #size-cells = <1>;
                rc_trim: trim@0 {
                    reg = <0 1>;
                };
            };
        };
    };
```

## Documentation/devicetree/bindings/power/supply/qcom,pmi8998-charger.yaml
```yaml
# SPDX-License-Identifier: GPL-2.0 OR BSD-2-Clause
%YAML 1.2
---
$id: http://devicetree.org/schemas/power/supply/qcom,pmi8998-charger.yaml#
$schema: http://devicetree.org/meta-schemas/core.yaml#

title: Qualcomm PMI8998/PM660 Switch-Mode Battery Charger "2"

maintainers:
  - Casey Connolly <casey.connolly@linaro.org>

properties:
  compatible:
    enum:
      - qcom,pmi8998-charger
      - qcom,pm660-charger

  reg:
    maxItems: 1

  interrupts:
    maxItems: 4

  interrupt-names:
    items:
      - const: usb-plugin
      - const: bat-ov
      - const: wdog-bark
      - const: usbin-icl-change

  io-channels:
    items:
      - description: USB in current in uA
      - description: USB in voltage in uV

  io-channel-names:
    items:
      - const: usbin_i
      - const: usbin_v

  monitored-battery: true

  input-current-limit-microamp:
    description: |
      Board ceiling for USB input-current configuration. Charger detection and
      consumer requests are bounded by this value; it is not authorization to
      draw that current from a connected source and does not raise fast-charge
      current. When absent the existing register-configuration ceiling is used.
    minimum: 25000
    maximum: 4800000
    multipleOf: 25000
    default: 4800000

required:
  - compatible
  - reg
  - interrupts
  - interrupt-names
  - io-channels
  - io-channel-names
  - monitored-battery

allOf:
  - $ref: power-supply.yaml#

additionalProperties: false

examples:
  - |
    #include <dt-bindings/interrupt-controller/irq.h>

    pmic {
      #address-cells = <1>;
      #size-cells = <0>;

      charger@1000 {
        compatible = "qcom,pmi8998-charger";
        reg = <0x1000>;

        interrupts = <0x2 0x12 0x2 IRQ_TYPE_EDGE_BOTH>,
                     <0x2 0x13 0x4 IRQ_TYPE_EDGE_BOTH>,
                     <0x2 0x13 0x6 IRQ_TYPE_EDGE_RISING>,
                     <0x2 0x16 0x1 IRQ_TYPE_EDGE_RISING>;
        interrupt-names = "usb-plugin", "bat-ov", "wdog-bark", "usbin-icl-change";

        io-channels = <&pmi8998_rradc 3>,
                      <&pmi8998_rradc 4>;
        io-channel-names = "usbin_i",
                           "usbin_v";

        monitored-battery = <&battery>;
      };
    };
```

## Documentation/devicetree/bindings/power/supply/qcom,pmi8998-fg.yaml
```yaml
# SPDX-License-Identifier: (GPL-2.0-only OR BSD-2-Clause)
%YAML 1.2
---
$id: http://devicetree.org/schemas/power/supply/qcom,pmi8998-fg.yaml#
$schema: http://devicetree.org/meta-schemas/core.yaml#

title: Qualcomm PMI8998 GEN3 fuel gauge

maintainers:
  - adkaore <adkaore@gmail.com>

description: |
  The GEN3 hardware includes battery measurement and state-of-charge blocks.
  The current driver reads direct registers only and depends on an already
  running gauge algorithm with the correct battery profile. It does not
  initialize the algorithm, load profiles, change calibration, restart the
  gauge or change protection thresholds. PMIC digital revisions 1 and 2 have
  different voltage/current byte order; the driver reads the PMIC revision.

allOf:
  - $ref: power-supply.yaml#

properties:
  compatible:
    const: qcom,pmi8998-fg

  reg:
    items:
      - const: 0x4000

  interrupts:
    items:
      - description: SOC ready
      - description: Monotonic SOC delta
      - description: Battery missing state change
      - description: Battery temperature delta

  interrupt-names:
    items:
      - const: soc-ready
      - const: soc-delta
      - const: batt-missing
      - const: batt-temp

  monitored-battery: true

  power-supplies:
    maxItems: 1
    description: Charger supplying authoritative charge status.

required:
  - compatible
  - reg
  - interrupts
  - interrupt-names
  - monitored-battery
  - power-supplies

unevaluatedProperties: false

examples:
  - |
    #include <dt-bindings/interrupt-controller/irq.h>
    pmic {
        #address-cells = <1>;
        #size-cells = <0>;
        interrupt-controller;
        #interrupt-cells = <4>;

        battery@4000 {
            compatible = "qcom,pmi8998-fg";
            reg = <0x4000>;
            interrupts = <2 0x40 1 IRQ_TYPE_EDGE_RISING>,
                         <2 0x40 3 IRQ_TYPE_EDGE_RISING>,
                         <2 0x41 3 IRQ_TYPE_EDGE_BOTH>,
                         <2 0x41 6 IRQ_TYPE_EDGE_RISING>;
            interrupt-names = "soc-ready", "soc-delta", "batt-missing", "batt-temp";
            monitored-battery = <&battery>;
            power-supplies = <&charger>;
        };
    };
```
