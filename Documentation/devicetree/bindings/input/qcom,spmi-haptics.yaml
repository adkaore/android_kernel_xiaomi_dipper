## Documentation/devicetree/bindings/usb/qcom,pmi8998-typec.yaml
```yaml
# SPDX-License-Identifier: (GPL-2.0-only OR BSD-2-Clause)
%YAML 1.2
---
$id: http://devicetree.org/schemas/usb/qcom,pmi8998-typec.yaml#
$schema: http://devicetree.org/meta-schemas/core.yaml#

title: Qualcomm PMI8998 Type-C controller and Power Delivery PHY

maintainers:
  - Max Furman <taygoth@gmail.com>

description: |
  The PMI8998 Type-C detection block resides in USBIN at 0x1300 and has
  one rollup interrupt. The PD PHY is a separate block at 0x1700. These
  resources differ from the PM8150B Type-C block and cannot use its binding.
  A board must provide its connector capabilities before enabling this node.

properties:
  compatible:
    const: qcom,pmi8998-typec

  reg:
    items:
      - description: Type-C detection block at 0x1300
      - description: PD PHY block at 0x1700

  interrupts:
    items:
      - description: Type-C change rollup
      - description: PD signal transmit complete
      - description: PD signal received
      - description: PD message transmit complete
      - description: PD message received
      - description: PD message transmit failed
      - description: PD message transmit discarded
      - description: PD message receive discarded

  interrupt-names:
    items:
      - const: type-c-change
      - const: sig-tx
      - const: sig-rx
      - const: msg-tx
      - const: msg-rx
      - const: msg-tx-failed
      - const: msg-tx-discarded
      - const: msg-rx-discarded

  vdd-vbus-supply:
    description: Switched VBUS output regulator.

  vdd-pdphy-supply:
    description: PD PHY analog supply.

  power-supplies:
    maxItems: 1
    description: Same-PMIC SMB2 charger controlling USB input suspend and current.

  connector:
    type: object
    $ref: /schemas/connector/usb-connector.yaml#
    unevaluatedProperties: false

  port:
    $ref: /schemas/graph.yaml#/properties/port
    description: USB data-role switching endpoint.

required:
  - compatible
  - reg
  - interrupts
  - interrupt-names
  - vdd-vbus-supply
  - vdd-pdphy-supply
  - power-supplies

additionalProperties: false

examples:
  - |
    #include <dt-bindings/interrupt-controller/irq.h>
    pmic {
        #address-cells = <1>;
        #size-cells = <0>;
        typec@1300 {
            compatible = "qcom,pmi8998-typec";
            reg = <0x1300>, <0x1700>;
            interrupts = <2 0x13 7 IRQ_TYPE_EDGE_BOTH>,
                         <2 0x17 0 IRQ_TYPE_EDGE_RISING>,
                         <2 0x17 1 IRQ_TYPE_EDGE_RISING>,
                         <2 0x17 2 IRQ_TYPE_EDGE_RISING>,
                         <2 0x17 3 IRQ_TYPE_EDGE_RISING>,
                         <2 0x17 4 IRQ_TYPE_EDGE_RISING>,
                         <2 0x17 5 IRQ_TYPE_EDGE_RISING>,
                         <2 0x17 6 IRQ_TYPE_EDGE_RISING>;
            interrupt-names = "type-c-change", "sig-tx", "sig-rx",
                              "msg-tx", "msg-rx", "msg-tx-failed",
                              "msg-tx-discarded", "msg-rx-discarded";
            vdd-vbus-supply = <&vbus>;
            vdd-pdphy-supply = <&vreg_l24>;
            power-supplies = <&charger>;
        };
    };
```
