// SPDX-License-Identifier: GPL-2.0
/* Xiaomi Mi 8 P0 v2.1; selectors match the pinned downstream board. */

/dts-v1/;

#include "sdm845-xiaomi-dipper-common.dtsi"

/ {
	model = "Xiaomi Mi 8 (P0 v2.1)";
	compatible = "xiaomi,dipper-p0-v2.1", "xiaomi,dipper", "qcom,sdm845";

	qcom,msm-id = <QCOM_ID_SDM845 0x20001>;
	qcom,board-id = <50 0>;
};
